## examples/spi_test/Kconfig
```kconfig
#
# For a description of the syntax of this configuration file,
# see the file kconfig-language.txt in the NuttX tools repository.
#

config EXAMPLES_SPI_TEST
	tristate "SPI Test example"
	default n
	---help---
		Enable the SPI Test example

if EXAMPLES_HELLO

config EXAMPLES_SPI_TEST_PROGNAME
	string "Program name"
	default "spi_test"
	---help---
		This is the name of the program that will be used when the NSH ELF
		program is installed.

config EXAMPLES_SPI_TEST_PRIORITY
	int "SPI Test task priority"
	default 100

config EXAMPLES_SPI_TEST_STACKSIZE
	int "SPI Test stack size"
	default DEFAULT_TASK_STACKSIZE

endif
```
